#include <Adafruit_GFX.h>    
#include <Adafruit_ST7735.h> 
#include <SPI.h>
#include <HX711.h>
#include <pgmspace.h> 

#define PIN_PUMP_RELAY    25  
#define PIN_LAM_LED       26  
#define PIN_GATE_1_SENSOR 14  
#define PIN_GATE_2_SENSOR 13  

#define LOADCELL_DOUT_PIN 33
#define LOADCELL_SCK_PIN  32

#define TFT_CS            15
#define TFT_RST           4 
#define TFT_DC            27  
#define TFT_MOSI          21
#define TFT_SCLK          22

#define PUMP_ON   HIGH
#define PUMP_OFF  LOW

#define LED_ON    HIGH
#define LED_OFF   LOW

const float PUMP_DURATION_MS = 3330; 
const float FORCE_TRIGGER_THRESHOLD = 50.0; 
const float TARGET_WEIGHT_MIN = 50.0; 
const float TARGET_WEIGHT_MAX = 200.0;

Adafruit_ST7735 tft = Adafruit_ST7735(TFT_CS, TFT_DC, TFT_MOSI, TFT_SCLK, TFT_RST);
HX711 scale;

bool gate1Passed = false;
bool gate2Passed = false;
bool simulationComplete = false;
unsigned long lastDisplayTime = 0;

void setPump(bool on);
void setLed(bool on);
void drawStatus(const char* line1, const char* line2);
void waitForSensorsClear();
void gameWonSequence(float finalWeight);
void retrySequence(float finalWeight);
void drawVictoryScreen();
void drawRetryScreen();

void setup() {
  Serial.begin(115200);

  pinMode(PIN_PUMP_RELAY, OUTPUT);
  setPump(false);

  pinMode(PIN_LAM_LED, OUTPUT);
  setLed(false);

  pinMode(PIN_GATE_1_SENSOR, INPUT_PULLUP);
  pinMode(PIN_GATE_2_SENSOR, INPUT_PULLUP);

  tft.initR(INITR_BLACKTAB); 
  tft.fillScreen(ST77XX_BLACK);
  tft.setRotation(1);
  tft.setTextColor(ST77XX_WHITE);
  
  tft.setCursor(10, 10); tft.println("Init Scale...");
  scale.begin(LOADCELL_DOUT_PIN, LOADCELL_SCK_PIN);
  scale.set_scale(-427.8); 
  scale.tare(); 
  waitForSensorsClear();

  Serial.println("System Ready. MOSFET Logic Active.");
  drawStatus("READY", "Waiting for G1...");
}

// --- MAIN LOOP ---
void loop() {
  if (simulationComplete) return; // Stop game

//Gate 1 
  if (!gate1Passed) {
    if (digitalRead(PIN_GATE_1_SENSOR) == LOW) {
      Serial.println("Stage 1 Triggered");
      
      drawStatus("GATE 1", "Pumping Fluid...");
      
      
      setPump(true);
      delay(PUMP_DURATION_MS); 
      setPump(false);
      
      drawStatus("DONE", "Proceed to G2 ->");
      
      gate1Passed = true; 
      delay(1000); 
    }
  }
  
  else if (!gate2Passed) {
    if (digitalRead(PIN_GATE_2_SENSOR) == LOW) {
      Serial.println("Stage 2 Triggered");

      drawStatus("GATE 2", "LED Activated!");
      setLed(true);
      
      gate2Passed = true; 
      delay(1000); 
    }
  }
  
  //stage3-partking
  else {
    float currentWeight = scale.get_units(2);
    
    
    if (millis() - lastDisplayTime > 200) {
      tft.fillRect(0, 100, 160, 20, ST77XX_BLACK); 
      tft.setCursor(10, 100);
      tft.setTextSize(1);
      tft.print("Live Wgt: "); tft.print(currentWeight, 0);
      lastDisplayTime = millis();
      
      tft.setCursor(10, 60); tft.print("Parking...");
    }

    if (currentWeight > FORCE_TRIGGER_THRESHOLD) {
      drawStatus("PARKED", "Analyzing...");
      
      for(int i=0; i<3; i++) {
        setLed(false); delay(200);
        setLed(true);  delay(200);
      }
      
      delay(1000);
      currentWeight = scale.get_units(10);
      
      if (currentWeight > TARGET_WEIGHT_MIN && currentWeight < TARGET_WEIGHT_MAX) {
        gameWonSequence(currentWeight);
      } else {
        retrySequence(currentWeight);
      }
    }
  }
}



void setPump(bool on) {

  digitalWrite(PIN_PUMP_RELAY, on ? PUMP_ON : PUMP_OFF);
}

void setLed(bool on) {
  digitalWrite(PIN_LAM_LED, on ? LED_ON : LED_OFF);
}

void drawStatus(const char* line1, const char* line2) {
  tft.fillScreen(ST77XX_BLACK);
  tft.setCursor(5, 10);
  tft.setTextSize(2);
  tft.setTextColor(ST77XX_GREEN);
  tft.println(line1);
  tft.setCursor(5, 40);
  tft.setTextSize(1);
  tft.setTextColor(ST77XX_WHITE);
  tft.println(line2);
}

void waitForSensorsClear() {
  while (digitalRead(PIN_GATE_1_SENSOR) == LOW || digitalRead(PIN_GATE_2_SENSOR) == LOW) {
    tft.fillScreen(ST77XX_RED);
    tft.setCursor(10, 10);
    tft.setTextColor(ST77XX_WHITE);
    tft.setTextSize(2);
    tft.println("WARNING!");
    tft.setTextSize(1);
    tft.setCursor(10, 40);
    tft.println("Sensors Blocked!");
    tft.setCursor(10, 60);
    tft.println("Clear area...");
    delay(500);
  }

  tft.fillScreen(ST77XX_BLACK);
}

void gameWonSequence(float finalWeight) {
  simulationComplete = true; 
  drawVictoryScreen();
  tft.setCursor(5, 110);
  tft.setTextColor(ST77XX_WHITE);
  tft.print("Final Wgt: "); tft.print(finalWeight, 1); tft.print("g");
}

void retrySequence(float finalWeight) {
  drawRetryScreen();
  tft.setCursor(10, 140);
  tft.setTextColor(ST77XX_WHITE); 
  tft.print("Got: "); tft.print(finalWeight, 1); tft.print("g");
  
  delay(5000);
  
  // RESET
  simulationComplete = false; 
  gate1Passed = false;
  gate2Passed = false;
  setLed(false);
  setPump(false);
  
  waitForSensorsClear(); 
  drawStatus("RESET", "Ready for G1...");
}

// --- BITMAP DATA ---
#define IMG_WIN_WIDTH 124
#define IMG_WIN_HEIGHT 62
static const uint8_t PROGMEM image_Connected_bits[] = {0x00,0x00,0x00,0x00,0x00,0x00,0x00,0x00,0x00,0x00,0x00,0x00,0x00,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0x0c,0x00};
static const uint8_t PROGMEM text_sim_complete[] = {0x5c,0x08,0x00,0x00,0x20,0x00,0x40,0x00,0x00,0x00,0x5f,0x00,0x00,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0x00,0x00};
#define IMG_LAYER3_WIDTH 119
#define IMG_LAYER3_HEIGHT 15
static const uint8_t PROGMEM image_Layer_3_bits[] = {0xe7, 0x70, 0x00, 0x02, 0x20, 0x00, 0xe0, 0x80, 0x43, 0x00, 0x00, 0x00, 0x00,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 0x00, 0x00};
#define IMG_DOLPHIN_WIDTH 49
#define IMG_DOLPHIN_HEIGHT 54
static const uint8_t PROGMEM image_dolph_cry_bits[] = {0x00, 0x00, 0xf0, 0x7f, 0x00, 0x00, 0x00, 0x00, 0x00, 0x0e, 0x80, 0x03, 0x00,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 0x02, 0x00};

void drawVictoryScreen() {
  tft.fillScreen(ST77XX_BLACK);
  tft.drawXBitmap(6, 15, text_sim_complete, 148, 15, ST77XX_WHITE);
  tft.drawXBitmap(18, 45, image_Connected_bits, IMG_WIN_WIDTH, IMG_WIN_HEIGHT, ST77XX_WHITE);
}

void drawRetryScreen() {
  tft.fillScreen(ST77XX_BLACK);
  tft.drawXBitmap(20, 20, image_Layer_3_bits, IMG_LAYER3_WIDTH, IMG_LAYER3_HEIGHT, ST77XX_WHITE);
  tft.drawXBitmap(55, 50, image_dolph_cry_bits, IMG_DOLPHIN_WIDTH, IMG_DOLPHIN_HEIGHT, ST77XX_WHITE);
}